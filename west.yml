## west.yml
```yaml
# The default West manifest file to be used for Zephyr.

west:
  url: https://github.com/zephyrproject-rtos/west
  revision: master

manifest:
  defaults:
    remote: upstream
    revision: master

  remotes:
    - name: upstream
      url-base: https://github.com/zephyrproject-rtos

  projects:
    - name: zephyr
      revision: topic-west
      west-commands: scripts/west-commands.yml
```
